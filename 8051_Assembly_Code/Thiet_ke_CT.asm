ORG 0000H
	LED0 EQU 5000H
	LED1 EQU 5800H
	LED2 EQU 6000H
	LED3 EQU 6800H
	JMP MAIN
ORG 0003H
	JMP EX0_ISR
ORG 0030H
;Chuong trinh chinh, chon MODE------------------------------------------------------------------------------------------------------------------------------
MAIN:
	CALL SET_UP_FOR_BEGINNING
	CALL MAIN_LCD
	MODE:
	CALL DISPLAY_STRING_MODE
	CALL KEYPAD
	CJNE A,#20H,NEXT
	MOV R7,A
	CALL CLEAR_LCD
	CALL DISPLAY_STRING_M2
	JMP NOT_PRESS_START
	NEXT:
	CJNE A,#10H,MODE
	MOV R7,A
;MODE 1, nhap so lieu tu ban phim ma tran------------------------------------------------------------------------------------------------------------------------------------------------------	
	CALL CLEAR_LCD
	CALL DISPLAY_STRING_M1
	MOV A,#0C0H
	CALL WRITE_COM
	MOV R0,#30H
	MOV R4,#4
	KEY:
	MOV R5,#3
	EXTEND:
	CALL DELAY_100ms
	DJNZ R5,EXTEND
	CALL KEYPAD
	MOV @R0,A
	INC R0
	DJNZ R4,KEY
;Xu ly chuong trinh hien thi va cac nut nhan-------------------------------------------------------------------------------------------------------------------------------------------------------
NOT_PRESS_START:
	MOV R0,#0
	MOV R1,#0
	MOV R2,#0
	MOV R3,#0
	HERE:	
	JB P2.0,HERE
	CALL DELAY_100ms
	JNB P2.0,PRESS_START
	JMP NOT_PRESS_START
PRESS_START:	
	JB P2.0,START
	JMP PRESS_START
START:
	SETB EA
	SETB EX0
	SETB TR0
	CALL CLEAR_LCD
	CALL DISPLAY_STRING
LOOP:
	JB P3.4,NEXT2
	CALL DELAY_400ms
	JNB P3.4,STILL0
	JMP NEXT2
	STILL0:
	CALL DELAY_400ms
	INC TL0
	NEXT2:
	MOV R0,TL0
	CALL COUNT
	CALL DISPLAY_NUMBER
	CALL DISPLAY_LED
	JNB P2.1,CHECK
	JMP CONTINUE
	CHECK:
	HERE2:
	JB P2.1,HERE2
	CALL DELAY_100ms
	JNB P2.1,PRESS_PAUSE
NOT_PRESS_PAUSE:
	JMP CONTINUE
PRESS_PAUSE:
PAUSE:
	CLR TR0
	JMP NOT_PRESS_START
CONTINUE:
	MOV A,R7
	CJNE A,#10H,FREE
	MOV A,R0
	CJNE A,33H,$+3
	JC LOOP
	MOV A,R1
	CJNE A,32H,LOOP
	MOV A,R2
	CJNE A,31H,LOOP
	MOV A,R3
	CJNE A,30H,LOOP
	CLR TR0
	JMP BLINK
	FREE:
	MOV A,R0
	CJNE A,#09H,LOOP
	MOV A,R1
	CJNE A,#09H,LOOP
	MOV A,R2
	CJNE A,#09H,LOOP
	MOV A,R3
	CJNE A,#09H,LOOP
	CLR TR0
BLINK:
	CLR EA
	CALL CLEAR_LCD
	CALL DELAY_100ms
	CALL DISPLAY_STRING_END
	CALL DELAY_100ms
	JB P2.2,BLINK
	HERE3:
	JB P2.2,HERE3
	CALL DELAY_100ms
	JNB P2.2,$
	JMP MAIN
;Thiet lap dau chuong trinh--------------------------------------------------------------------------------------------------------------------------------------------------------
SET_UP_FOR_BEGINNING:
	CLEAR_LED:
	MOV A,#0FFH
	MOV DPTR,#LED0
	MOVX @DPTR,A
	MOV DPTR,#LED1
	MOVX @DPTR,A
	MOV DPTR,#LED2
	MOVX @DPTR,A
	MOV DPTR,#LED3
	MOVX @DPTR,A
	SET_UP:
	SETB P2.0
	SETB P2.1
	SETB P3.2
	MOV TMOD,#00010101B
	MOV TH0,#0
	MOV TL0,#0
	RET
;Chuong trinh phuc vu ngat ngoai INT0 cho nut nhan RESET--------------------------------------------------------------------------------------------------------------------------------------------------------
EX0_ISR:
	JNB P3.2,$+2
	HERE1:
	JB P3.2,HERE1
	CALL DELAY_100ms
	WAIT_INTERRUPT:
	JB IE0,WAIT_INTERRUPT
	MOV R0,#0
	MOV R1,#0
	MOV R2,#0
	MOV R3,#0
	MOV TL0,#0
	CALL DISPLAY_NUMBER
	MOV A,#0EH
	CALL WRITE_COM
	MOV A,#00H
	CALL WRITE_TEXT
	MOV A,#0FH
	CALL WRITE_COM
	MOV A,#00H
	CALL WRITE_TEXT
	CALL DISPLAY_LED
	RETI
;Chuong trinh chot LED------------------------------------------------------------------------------------------------------------------------------------------------------
DISPLAY_LED:
	MOV A,R0
	MOV DPTR,#LED0
	MOVX @DPTR,A
	MOV A,R1
	MOV DPTR,#LED1
	MOVX @DPTR,A
	MOV A,R2
	MOV DPTR,#LED2
	MOVX @DPTR,A
	MOV A,R3
	MOV DPTR,#LED3
	MOVX @DPTR,A
	RET
;Chuong trinh xu ly so lieu dem duoc------------------------------------------------------------------------------------------------------------------------------------------------------
COUNT:
	MOV A,R0
	CJNE A,#10,$+3
	JC UNITROW
	CJNE A,#11,NEXT1
	INC R1
	MOV TL0,#1
	JMP SKIP
	NEXT1:
	INC R1
	RESET_TIMER:
	MOV TH0,#0
	MOV TL0,#0
	SKIP:
	MOV R0,TL0
	MOV A,R1
	CJNE A,#10,DOZENS
	MOV R1,#0
	INC R2
	MOV A,R2
	CJNE A,#10,HUNDREDS
	MOV R2,#0
	INC R3
	MOV A,R3
	CJNE A,#10,THOUSANDS
	MOV R3,#0
	THOUSANDS:
	HUNDREDS:
	DOZENS:
	MOV A,R0
	UNITROW:
	MOV R0,A
	RET	
;Chuong trinh LCD------------------------------------------------------------------------------------------------------------------------------------------------------
DISPLAY_LCD:
	E BIT P3.3
	RS BIT P3.5
	LCDADDR	EQU 7000H
MAIN_LCD:
	MOV DPTR,#LCDADDR
	CALL INITIAL_LCD
	CALL CLEAR_LCD
	RET
DISPLAY_STRING_M2:
	PUSH ACC
	MOV A,#80H
	CALL WRITE_COM
	CALL DISPLAY_STRING8
	POP ACC
	RET
DISPLAY_STRING_MODE:
	PUSH ACC
	MOV A,#80H
	CALL WRITE_COM
	CALL DISPLAY_STRING6
	MOV A,#0C0H
	CALL WRITE_COM
	CALL DISPLAY_STRING7
	POP ACC
	RET
DISPLAY_STRING_M1:
	PUSH ACC
	MOV A,#80H
	CALL WRITE_COM
	CALL DISPLAY_STRING3
	MOV A,#0C4H
	CALL WRITE_COM
	CALL DISPLAY_STRING4
	POP ACC
	RET
DISPLAY_STRING_END:
	PUSH ACC
	MOV A,#80H
	CALL WRITE_COM
	CALL DISPLAY_STRING5
	POP ACC
	RET
DISPLAY_STRING:
	PUSH ACC
	MOV A,#80H
	CALL WRITE_COM
	CALL DISPLAY_STRING1
	MOV A,#0C0H
	CALL WRITE_COM
	CALL DISPLAY_STRING2
	POP ACC
	RET
DISPLAY_NUMBER:
	PUSH ACC
	MOV A,#0CAH
	CALL WRITE_COM
	CALL SHOW_NUMBER
	MOV A,#0CH
	CALL WRITE_COM
	POP ACC
	RET
INITIAL_LCD: 
	MOV A,#38H
	CALL WRITE_COM
	MOV A,#0CH
	CALL WRITE_COM
	MOV A,#06H
	CALL WRITE_COM
	RET
CLEAR_LCD:
	MOV A,#01H
	CALL WRITE_COM
	RET
WRITE_COM:
	MOV DPTR,#LCDADDR
	SETB E
	CLR RS
	MOVX @DPTR,A
	CLR E
	CALL DELAY_1ms
	RET
WRITE_TEXT:
	MOV DPTR,#LCDADDR
	SETB E
	SETB RS
	MOVX @DPTR,A
	CLR E
	CALL DELAY_1ms
	RET
DISPLAY_STRING1:
	PUSH 00H
	PUSH ACC
	MOV R0,#0
	LOOP1:
	MOV DPTR,#STRING1
	MOV A,R0
	MOVC A,@A+DPTR
	JZ EXIT1
	CALL WRITE_TEXT
	INC R0
	JMP LOOP1
	EXIT1:
	POP ACC
	POP 00H
	RET
	STRING1: DB "Ten: Mi goi",0
DISPLAY_STRING2:
	PUSH 00H
	PUSH ACC
	MOV R0,#0
	LOOP2:
	MOV DPTR,#STRING2
	MOV A,R0
	MOVC A,@A+DPTR
	JZ EXIT2
	CALL WRITE_TEXT
	INC R0
	JMP LOOP2
	EXIT2:
	POP ACC
	POP 00H
	RET
	STRING2: DB "So luong:",0
DISPLAY_STRING3:
	PUSH 00H
	PUSH ACC
	MOV R0,#0
	LOOP3:
	MOV DPTR,#STRING3
	MOV A,R0
	MOVC A,@A+DPTR
	JZ EXIT3
	CALL WRITE_TEXT
	INC R0
	JMP LOOP3
	EXIT3:
	POP ACC
	POP 00H
	RET
	STRING3: DB "Nhap so luong:",0	
DISPLAY_STRING4:
	PUSH 00H
	PUSH ACC
	MOV R0,#0
	LOOP4:
	MOV DPTR,#STRING4
	MOV A,R0
	MOVC A,@A+DPTR
	JZ EXIT4
	CALL WRITE_TEXT
	INC R0
	JMP LOOP4
	EXIT4:
	POP ACC
	POP 00H
	RET
	STRING4: DB "/9999",0	
DISPLAY_STRING5:
	PUSH 00H
	PUSH ACC
	MOV R0,#0
	LOOP5:
	MOV DPTR,#STRING5
	MOV A,R0
	MOVC A,@A+DPTR
	JZ EXIT5
	CALL WRITE_TEXT
	INC R0
	JMP LOOP5
	EXIT5:
	POP ACC
	POP 00H
	RET
	STRING5: DB "Da dem du! ",0	
DISPLAY_STRING6:
	PUSH 00H
	PUSH ACC
	MOV R0,#0
	LOOP6:
	MOV DPTR,#STRING6
	MOV A,R0
	MOVC A,@A+DPTR
	JZ EXIT6
	CALL WRITE_TEXT
	INC R0
	JMP LOOP6
	EXIT6:
	POP ACC
	POP 00H
	RET
	STRING6: DB "Moi chon che do",0
DISPLAY_STRING7:
	PUSH 00H
	PUSH ACC
	MOV R0,#0
	LOOP7:
	MOV DPTR,#STRING7
	MOV A,R0
	MOVC A,@A+DPTR
	JZ EXIT7
	CALL WRITE_TEXT
	INC R0
	JMP LOOP7
	EXIT7:
	POP ACC
	POP 00H
	RET
	STRING7: DB "Mode: M1 hoac M2",0
DISPLAY_STRING8:
	PUSH 00H
	PUSH ACC
	MOV R0,#0
	LOOP8:
	MOV DPTR,#STRING8
	MOV A,R0
	MOVC A,@A+DPTR
	JZ EXIT8
	CALL WRITE_TEXT
	INC R0
	JMP LOOP8
	EXIT8:
	POP ACC
	POP 00H
	RET
	STRING8: DB "Dem tu do",0
SHOW_NUMBER:
	MOV A,R3
	ADD A,#30H
	CALL WRITE_TEXT
	MOV A,R2
	ADD A,#30H
	CALL WRITE_TEXT
	MOV A,R1
	ADD A,#30H
	CALL WRITE_TEXT
	MOV A,R0
	ADD A,#30H
	CALL WRITE_TEXT
	RET
;Chuong trinh ban phim ma tran-------------------------------------------------------------------------------------------------------------------------------------------------------
KEYPAD:
	MOV P1,#0FFH
MAIN2:
	MOV A,#11101111B
	MOV R1,#4
	RETURN:
	MOV P1,A
	RL A
	JB P1.0,PASS1
	CALL DELAY_100ms
	JNB P1.0,ROW0
	PASS1:
	JB P1.1,PASS2
	CALL DELAY_100ms
	JNB P1.1,ROW1
	PASS2:
	JB P1.2,PASS3
	CALL DELAY_100ms
	JNB P1.2,ROW2
	PASS3:
	JB P1.3,PASS4
	CALL DELAY_100ms
	JNB P1.3,ROW3
	PASS4:
	DJNZ R1,RETURN
	JMP MAIN2
ROW0: 
	JNB P1.4,NUMBER7
	JNB P1.5,NUMBER8
	JNB P1.6,NUMBER9
	JNB P1.7,M1
ROW1:
	JNB P1.4,NUMBER4
	JNB P1.5,NUMBER5
	JNB P1.6,NUMBER6
	JNB P1.7,M2
ROW2:
	JNB P1.4,NUMBER1
	JNB P1.5,NUMBER2
	JNB P1.6,NUMBER3
	JNB P1.7,ENDING
ROW3:
	JNB P1.4,ENDING
	JNB P1.5,NUMBER0
	JNB P1.6,ENDING
	JNB P1.7,ENDING
	JMP $
	NUMBER0: MOV A,#30H
	JMP OUT
	NUMBER1: MOV A,#31H
	JMP OUT
	NUMBER2: MOV A,#32H
	JMP OUT
	NUMBER3: MOV A,#33H
	JMP OUT
	NUMBER4: MOV A,#34H
	JMP OUT
	NUMBER5: MOV A,#35H
	JMP OUT
	NUMBER6: MOV A,#36H
	JMP OUT
	NUMBER7: MOV A,#37H
	JMP OUT
	NUMBER8: MOV A,#38H
	JMP OUT
	NUMBER9: MOV A,#39H
	JMP OUT
	M1: MOV A,#10H
	JMP ENDING
	M2: MOV A,#20H
	JMP ENDING
OUT:
	CALL WRITE_TEXT
	CLR C
	SUBB A,#30H
ENDING:
	RET
;Chuong trinh DELAY------------------------------------------------------------------------------------------------------------------------------------------------------
DELAY_1ms:
	PUSH 07H
	PUSH 06H
	MOV R6,#2
	AGAIN:	
	MOV R7,#250
	DJNZ R7,$
	DJNZ R6,AGAIN
	POP 06H
	POP 07H
	RET
DELAY_100ms: 
	PUSH 07H
	PUSH 06H
	MOV R7,#200
	AGAIN1:	
	MOV R6,#250
	DJNZ R6,$
	DJNZ R7,AGAIN1
	POP 06H
	POP 07H
	RET
DELAY_400ms:
	PUSH 06H
	MOV R6,#8
	RETURN1:
	MOV TH1,#HIGH(-50000)
	MOV TL1,#LOW(-50000)
	SETB TR1
	WAIT: JNB TF1,WAIT
	CLR TR1
	CLR TF1
	DJNZ R6,RETURN1
	POP 06H
	RET
END
